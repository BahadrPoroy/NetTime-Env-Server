#define LOGO_HEIGHT 64
#define LOGO_WIDTH 128

const unsigned char logo_bmp[] PROGMEM = { 0xFF, 0xFF, 0xFF, 0xFF, 0xFF, 0xFF, 0xFF, 0xF0, 0x3F, 0xFF, 0xFF, 0xFF, 0xFF, 0xFF, 0xFF, 0xFE,
                                           0xFF, 0xFF, 0xFF, 0xFF, 0xFF, 0xFF, 0xFF, 0xF0, 0x3F, 0xFF, 0xFF, 0xFF, 0xFF, 0xFF, 0xFF, 0xFE,
                                           0xFF, 0xFF, 0xFF, 0xFF, 0xFF, 0xFF, 0xFF, 0xF0, 0x3F, 0xFF, 0xFF, 0xFF, 0xFF, 0xFF, 0xFF, 0xFE,
                                           0xFF, 0xFF, 0xFF, 0xFF, 0xFF, 0xFF, 0xFF, 0xF0, 0x3F, 0xFF, 0xFF, 0xFF, 0xFF, 0xFF, 0xFF, 0xFE,
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                                           0xFC, 0x1F, 0xFF, 0xFF, 0xFF, 0xFF, 0xFF, 0xFF, 0xFF, 0xFF, 0xFF, 0xFF, 0xFF, 0xFF, 0xFF, 0xFE };

void displayBrandLogo() {
  display.clearDisplay();
  int xPos = (display.width() - LOGO_WIDTH) / 2;
  int yPos = (display.height() - LOGO_HEIGHT) / 2;
  display.drawBitmap(xPos, yPos, logo_bmp, LOGO_WIDTH, LOGO_HEIGHT, SH110X_WHITE);
  display.display();
}

void drawWiFiIcon(long rssi) {
  int level = 0;
  const int iconSize = 16;
  const int x = 0;
  const int y = 64 - iconSize;
  const int barWidth = 3;
  const int space = 2;

  display.fillRect(x, y, iconSize, iconSize, SH110X_BLACK);

  if (WiFi.status() != WL_CONNECTED) {
    for (int i = 0; i < 5; i++) {
      int barHeight = 3 + i * 2;
      display.drawRect(x + i * 5, y + iconSize - barHeight, barWidth, barHeight, SH110X_WHITE);
    }
    display.drawLine(x + 2, y + 2, x + 10, y + 10, SH110X_WHITE);
    display.drawLine(x + 10, y + 2, x + 2, y + 10, SH110X_WHITE);
  } else {
    if (rssi > -50) level = 5;
    else if (rssi > -60) level = 4;
    else if (rssi > -70) level = 3;
    else if (rssi > -80) level = 2;
    else if (rssi > -90) level = 1;

    for (int i = 0; i < level; i++) {
      int barHeight = 3 + i * 2;
      display.fillRect(x + i * 5, y + iconSize - barHeight, barWidth, barHeight, SH110X_WHITE);
    }
  }
}